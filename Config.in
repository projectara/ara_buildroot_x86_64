## Config.in
```kconfig
source "$BR2_EXTERNAL_ARA_PATH/package/greybus/Config.in"
source "$BR2_EXTERNAL_ARA_PATH/package/gbsim/Config.in"
source "$BR2_EXTERNAL_ARA_PATH/package/libusbg/Config.in"
source "$BR2_EXTERNAL_ARA_PATH/package/gbutils/Config.in"
source "$BR2_EXTERNAL_ARA_PATH/package/greybus_loopback_test/Config.in"
```

## configs/ara_qemu_x86_64_defconfig
```kconfig
BR2_x86_64=y
BR2_x86_corei7=y
BR2_CCACHE=y
BR2_KERNEL_HEADERS_VERSION=y
BR2_DEFAULT_KERNEL_VERSION="4.2.3"
BR2_PACKAGE_HOST_LINUX_HEADERS_CUSTOM_4_2=y
BR2_TOOLCHAIN_BUILDROOT_GLIBC=y
BR2_TOOLCHAIN_BUILDROOT_CXX=y
BR2_TARGET_GENERIC_GETTY_PORT="ttyS0"
BR2_ROOTFS_OVERLAY="$(BR2_EXTERNAL)/board/ara/overlay"
BR2_ROOTFS_POST_BUILD_SCRIPT="$(BR2_EXTERNAL)/board/ara/qemu_x86_64/overlay_s50.sh"
BR2_LINUX_KERNEL=y
BR2_LINUX_KERNEL_CUSTOM_VERSION=y
BR2_LINUX_KERNEL_CUSTOM_VERSION_VALUE="4.2.3"
BR2_LINUX_KERNEL_USE_CUSTOM_CONFIG=y
BR2_LINUX_KERNEL_CUSTOM_CONFIG_FILE="$(BR2_EXTERNAL)/board/ara/qemu_x86_64/linux-4.2.config"
BR2_PACKAGE_GDB=y
BR2_PACKAGE_OPENSSL=y
BR2_PACKAGE_LIBCONFIG=y
BR2_PACKAGE_LIBSOC=y
BR2_PACKAGE_LIBUSB=y
BR2_PACKAGE_DROPBEAR=y
BR2_PACKAGE_DROPBEAR_DISABLE_REVERSEDNS=y
BR2_PACKAGE_TMUX=y
BR2_TARGET_ROOTFS_EXT2=y
# BR2_TARGET_ROOTFS_TAR is not set
BR2_PACKAGE_GREYBUS=y
BR2_PACKAGE_GBSIM=y
BR2_PACKAGE_LIBUSBG=y
```

## configs/ara_qemu_x86_64_staging_next_defconfig
```kconfig
BR2_x86_64=y
BR2_x86_corei7=y
BR2_CCACHE=y
BR2_TOOLCHAIN_BUILDROOT_GLIBC=y
BR2_TOOLCHAIN_BUILDROOT_CXX=y
BR2_ROOTFS_DEVICE_CREATION_DYNAMIC_EUDEV=y
BR2_TARGET_GENERIC_GETTY_PORT="ttyS0"
BR2_ROOTFS_OVERLAY="$(BR2_EXTERNAL_ARA_PATH)/board/ara/overlay"
BR2_ROOTFS_POST_BUILD_SCRIPT="$(BR2_EXTERNAL_ARA_PATH)/board/ara/qemu_x86_64/overlay_s50.sh"
BR2_LINUX_KERNEL=y
BR2_LINUX_KERNEL_CUSTOM_GIT=y
BR2_LINUX_KERNEL_CUSTOM_REPO_URL="git://git.kernel.org/pub/scm/linux/kernel/git/gregkh/staging.git"
BR2_LINUX_KERNEL_CUSTOM_REPO_VERSION="staging-next"
BR2_LINUX_KERNEL_USE_CUSTOM_CONFIG=y
BR2_LINUX_KERNEL_CUSTOM_CONFIG_FILE="$(BR2_EXTERNAL_ARA_PATH)/board/ara/qemu_x86_64/linux-staging-next.config"
BR2_PACKAGE_GDB=y
BR2_PACKAGE_LIBCONFIG=y
BR2_PACKAGE_LIBSOC=y
BR2_PACKAGE_LIBUSB=y
BR2_PACKAGE_TMUX=y
BR2_TARGET_ROOTFS_EXT2=y
# BR2_TARGET_ROOTFS_TAR is not set
BR2_PACKAGE_GBSIM=y
BR2_PACKAGE_LIBUSBG=y
BR2_PACKAGE_GBUTILS=y
```

## package/gbsim/Config.in
```kconfig
config BR2_PACKAGE_GBSIM
	bool "gbsim"
	depends on BR2_TOOLCHAIN_HAS_THREADS
	depends on BR2_PACKAGE_LIBSOC
	depends on BR2_PACKAGE_LIBUSBG
	help
	  gbsim is a simulator for greybus

	  https://github.com/jackmitch/libsoc

comment "gbsim needs a toolchain w/ threads and libsoc, libusbg"
	depends on !BR2_TOOLCHAIN_HAS_THREADS
```

## package/gbutils/Config.in
```kconfig
config BR2_PACKAGE_GBUTILS
	bool "gbutils"
	help
	  Greybus utilitys

	  https://github.com/projectara/gb-utils
```

## package/greybus/Config.in
```kconfig
config BR2_PACKAGE_GREYBUS
	bool "greybus"
	depends on BR2_LINUX_KERNEL
	help
	  Greybus kernel module

comment "greybus needs a Linux kernel to be built"
	depends on !BR2_LINUX_KERNEL
```

## package/greybus_loopback_test/Config.in
```kconfig
config BR2_PACKAGE_GREYBUS_LOOPBACK_TEST
	bool "greybus loopback test"
	depends on BR2_LINUX_KERNEL
	help
          Greybus loopback test tool is used to run performance test
          across greybus to loopback enabled Interfaces.
```

## package/libusbg/Config.in
```kconfig
config BR2_PACKAGE_LIBUSBG
	bool "libusbg"
	depends on BR2_TOOLCHAIN_HAS_THREADS
	help
	  libusbg is a C library for interfacing with usb gadteg

	  https://github.com/libusbg/libusbg

comment "libusbg needs a toolchain w/ threads"
	depends on !BR2_TOOLCHAIN_HAS_THREADS
```
